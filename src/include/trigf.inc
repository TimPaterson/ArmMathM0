/*
 * trigf.inc
 *
 * Created: 7/17/2023 11:53:18 AM
 *  Author: Tim
 */ 


.set	TAN_X_EQUALS_X_EXP,	-12
.set	COS_X_EQUALS_1_EXP,	-12
.set	PI_MANTISSA,		0xC90FDAA2	// p30 for pi, p31 for pi/2, p32 for pi/4
.set	PI_MANTISSA_LO,		0x2168C235	// next 32 bits
.set	PI_MANTISSA_FLOAT,	((PI_MANTISSA >> (EXP_BITS32 - 1)) + 1) >> 1
.set	ONE_OVER_PI_MANTISSA,	0xa2f9836E	// p33 for 1/pi, p31 for 4/pi

// for atan2f
.set	ATAN_TABLE_ENTRIES,		14
.set	ATAN_TABLE_END_OFFSET,		ATAN_TABLE_ENTRIES * 4
.set	SMALL_ATAN_TABLE_ENTRIES,	7
.set	SMALL_ATAN_TABLE_OFFSET,	ATAN_TABLE_ENTRIES * 4		// offset from __fullAtanTable
.set	SMALL_ATAN_TABLE_END_OFFSET,	SMALL_ATAN_TABLE_ENTRIES * 4	// offset from AtanTableEnd
.set	SMALL_ATAN_TABLE_START_I,	ATAN_TABLE_ENTRIES - SMALL_ATAN_TABLE_ENTRIES
.set	SMALL_ATAN_TABLE_SHIFT,		38 - 32

// for sinf
.set	SINE_ATAN_TABLE_ENTRIES,	ATAN_TABLE_ENTRIES - 1
.set	SINE_TABLE_END_OFFSET,		SINE_ATAN_TABLE_ENTRIES * 4
.set	SMALL_SINE_ATAN_TABLE_ENTRIES,	SMALL_ATAN_TABLE_ENTRIES - 1
.set	SMALL_SINE_ATAN_TABLE_OFFSET,	SMALL_ATAN_TABLE_OFFSET	// offset from __sineAtanTable
